## boards/native_sim_native_64.conf
```kconfig
# SPDX-License-Identifier: MPL-2.0

CONFIG_SERIAL=y
CONFIG_GPIO=y
CONFIG_SDL_DISPLAY_USE_HARDWARE_ACCELERATOR=n
```

## drivers/audio/Kconfig
```kconfig
# Copyright (c) 2026 OSKey contributors
# SPDX-License-Identifier: Apache-2.0

config AUDIO_ES8311
	bool "Everest ES8311 audio codec"
	default y
	depends on DT_HAS_EVEREST_ES8311_ENABLED
	select I2C
	select GPIO
	help
	  Enable driver for the Everest ES8311 low power audio codec. The
	  NS4150B class-D amplifier enable pin is driven through the
	  pa-en-gpios devicetree property. The driver is selected by the
	  devicetree node and does not depend on an application feature.

config AUDIO_ES8311_INIT_PRIORITY
	int "ES8311 codec initialization priority"
	depends on AUDIO_ES8311
	default 60

config AUDIO_ES7210
	bool "Everest ES7210 audio ADC"
	depends on DT_HAS_EVEREST_ES7210_ENABLED
	select I2C
	help
	  Enable the Everest ES7210 audio ADC in standard stereo I2S mode.
	  MIC1/MIC2 selection and initial gain are configured through
	  devicetree. The driver exposes Zephyr's audio codec API and can be
	  selected by an application feature or enabled directly.

config AUDIO_ES7210_INIT_PRIORITY
	int "ES7210 codec initialization priority"
	depends on AUDIO_ES7210
	default 60
```

## drivers/dts/bindings/audio/everest,es7210.yaml
```yaml
# SPDX-License-Identifier: MPL-2.0

description: Everest ES7210 audio ADC in standard stereo I2S mode

compatible: "everest,es7210"

include: i2c-device.yaml

properties:
  input-channel-mask:
    type: int
    default: 3
    enum: [1, 2, 3]
    description: |
      Enabled analog input channels as a bit mask: bit 0 is MIC1 and bit 1
      is MIC2. MIC3/MIC4 require TDM and are not exposed by this binding.

  mic-gain:
    type: int
    default: 8
    enum: [0, 1, 2, 3, 4, 5, 6, 7, 8, 9, 10, 11, 12, 13, 14]
    description: |
      Initial PGA gain code shared by all enabled microphones. Codes 0
      through 11 select 0 dB through 33 dB in 3 dB steps; codes 12, 13,
      and 14 select 34.5 dB, 36 dB, and 37.5 dB respectively.
```

## drivers/dts/bindings/audio/everest,es8311.yaml
```yaml
description: Everest ES8311 low power mono audio codec (DAC output)

compatible: "everest,es8311"

include: i2c-device.yaml

properties:
  pa-en-gpios:
    type: phandle-array
    required: false
    description: |
      Optional GPIO that enables the speaker power amplifier
      (e.g. NS4150B PA_EN behind an I/O expander).
```

## drivers/dts/bindings/security/nxp,a5000.yaml
```yaml
# SPDX-License-Identifier: MPL-2.0
description: NXP A5000 secure element using the nano-package T=1 over I2C transport
compatible: "nxp,a5000"
include: i2c-device.yaml
properties:
  enable-gpios:
    type: phandle-array
    description: Optional chip enable, active level supplied by GPIO flags
```

## drivers/dts/bindings/sensor/oskey,qmi8658a-fifo.yaml
```yaml
# SPDX-License-Identifier: MPL-2.0

description: QST QMI8658A FIFO-backed OSKey IMU source

compatible: "oskey,qmi8658a-fifo"

include: [sensor-device.yaml, i2c-device.yaml]

properties:
  accel-fs:
    type: int
    default: 4
    enum: [2, 4, 8, 16]
    description: Accelerometer full-scale range in g.

  gyro-fs:
    type: int
    default: 512
    enum: [16, 32, 64, 128, 256, 512, 1024, 2048]
    description: Gyroscope full-scale range in degrees per second.

  accel-odr:
    type: int
    default: 112
    description: Requested accelerometer output data rate in Hz.

  gyro-odr:
    type: int
    default: 112
    description: Requested gyroscope output data rate in Hz.

  poll-interval-us:
    type: int
    default: 4000
    description: |
      Period of the software timer used to inspect and drain the FIFO when no
      interrupt line is available. This controls retrieval latency, not the
      physical sensor output data rate.
```

## drivers/dts/bindings/video/galaxycore,gc0308.yaml
```yaml
# Copyright (c) 2026 OSKey contributors
# SPDX-License-Identifier: Apache-2.0

description: GalaxyCore GC0308 CMOS video sensor

compatible: "galaxycore,gc0308"

include: i2c-device.yaml

properties:
  pwdn-gpios:
    type: phandle-array
    description: Active-high sensor power-down signal

  reset-gpios:
    type: phandle-array
    description: Active-low sensor reset signal

  h-mirror:
    type: boolean
    description: Enable horizontal image mirroring

child-binding:
  child-binding:
    include: video-interfaces.yaml
```

## drivers/sensor/qmi8658a_fifo/Kconfig
```kconfig
# SPDX-License-Identifier: MPL-2.0

config OSKEY_QMI8658A_FIFO
	bool
	depends on DT_HAS_OSKEY_QMI8658A_FIFO_ENABLED
	select I2C
	help
	  Enable the synchronous QMI8658A FIFO backend. The portable IMU thread
	  owns scheduling and calls this backend directly, so no RTIO context or
	  driver work queue is required.

config OSKEY_QMI8658A_FIFO_INIT_PRIORITY
	int
	depends on OSKEY_QMI8658A_FIFO
	default 90
	help
	  Device initialization priority. This must run after the I2C controller.
```

## drivers/video/Kconfig
```kconfig
# Copyright (c) 2026 OSKey contributors
# SPDX-License-Identifier: Apache-2.0

config VIDEO_GC0308
	bool "GC0308 CMOS digital image sensor"
	depends on VIDEO_DRIVERS
	default y
	depends on DT_HAS_GALAXYCORE_GC0308_ENABLED
	select I2C
	select GPIO
	help
	  Enable driver for the GalaxyCore GC0308 CMOS digital image sensor.
```

## src/audio/Kconfig
```kconfig
# SPDX-License-Identifier: MPL-2.0
config OSKEY_MICROPHONE
	bool "USB microphone"
	default n
	depends on OSKEY_USB
	depends on DT_HAS_ESPRESSIF_ESP32_I2S_ENABLED
	depends on DT_HAS_EVEREST_ES7210_ENABLED
	select OSKEY_AUDIO
	select AUDIO_ES7210
	select USBD_AUDIO2_CLASS
	select RING_BUFFER
	help
	  Expose the board's two ES7210 microphone channels as a USB Audio Class 2
	  stereo recording device. The interface remains enumerated while runtime
	  capture is disabled and supplies silence until the status-bar microphone
	  switch is enabled.

config OSKEY_MICROPHONE_STACK_SIZE
	int "USB microphone capture thread stack size"
	depends on OSKEY_MICROPHONE
	default 2048
	help
	  Stack used by the continuous I2S microphone capture thread.
```

## src/tests/input/testcase.yaml
```yaml
# SPDX-License-Identifier: MPL-2.0
tests:
  oskey.input:
    platform_allow:
      - native_sim/native/64
    integration_platforms:
      - native_sim/native/64
    tags:
      - input
      - gui
    timeout: 10
```
