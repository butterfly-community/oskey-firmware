## boards/lichuang_esp32s3.conf
```kconfig
CONFIG_I2C=y
CONFIG_DMA=y
CONFIG_INPUT=y
CONFIG_ST7789V=y
CONFIG_ST7789V_RGB888=y
CONFIG_SPI_INIT_PRIORITY=80
# CONFIG_SPI_ESP32_INTERRUPT=y
```

## boards/native_sim.conf
```kconfig
CONFIG_UART_USE_RUNTIME_CONFIGURE=y
CONFIG_SERIAL=y

# BT
CONFIG_BT=y
CONFIG_BT_PERIPHERAL=y
CONFIG_BT_SMP=y
CONFIG_BT_SMP_SC_ONLY=y
CONFIG_BT_SMP_SC_PAIR_ONLY=y
CONFIG_BT_DEVICE_NAME="OHW"
CONFIG_BT_ZEPHYR_NUS=y
CONFIG_BT_DEVICE_NAME_DYNAMIC=y
CONFIG_BT_DEVICE_APPEARANCE=0
CONFIG_BT_L2CAP_TX_MTU=247
CONFIG_BT_BUF_ACL_TX_SIZE=251
CONFIG_BT_BUF_ACL_RX_SIZE=502
CONFIG_BT_CTLR_DATA_LENGTH_MAX=251
CONFIG_BT_RX_STACK_SIZE=2400
CONFIG_BT_KEYS_OVERWRITE_OLDEST=y
CONFIG_BT_MAX_PAIRED=3

# Settings
CONFIG_BT_SETTINGS=y
CONFIG_SETTINGS=y

# Other
CONFIG_ZCBOR=y
CONFIG_STATS=y

# Display
CONFIG_DISPLAY=y
CONFIG_INPUT=y
CONFIG_LVGL=y
CONFIG_LV_Z_MEM_POOL_SIZE=20480
CONFIG_LV_Z_SHELL=y
# CONFIG_LV_USE_SYSMON=y
CONFIG_LV_USE_MONKEY=y
CONFIG_LV_USE_FONT_COMPRESSED=y
CONFIG_LV_USE_PERF_MONITOR=y
CONFIG_LV_COLOR_DEPTH_32=y
CONFIG_LV_FONT_MONTSERRAT_32=y
```

## boards/overlay_debug.conf
```kconfig
CONFIG_DEBUG=y
CONFIG_STACK_USAGE=y
CONFIG_DEBUG_COREDUMP=n
# CONFIG_DEBUG_COREDUMP_BACKEND_LOGGING=y
CONFIG_BOOT_BANNER=n
```

## boards/rpi_pico.conf
```kconfig
# CONFIG_USB_DEVICE_STACK=y
# CONFIG_USB_DEVICE_PRODUCT="RPi Pico USB Serial Console"
# CONFIG_USB_DEVICE_VID=0001
# CONFIG_USB_CDC_ACM_LOG_LEVEL_OFF=y

# CONFIG_SERIAL=y
# CONFIG_CONSOLE=y
# CONFIG_UART_CONSOLE=y
```
