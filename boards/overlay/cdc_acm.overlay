/* SPDX-License-Identifier: MPL-2.0 */

/ {
  aliases {
    app-uart = &cdc_acm_uart0;
  };
};

&zephyr_udc0 {
  cdc_acm_uart0: cdc_acm_uart0 {
    compatible = "zephyr,cdc-acm-uart";
    label = "OSKey";
  };
};
